/*
 * A dedicated address set for this Kumbung-based firmware variant.
 * This is an address, not encryption or authentication.
 */

/ {
    esb_split {
        compatible = "zmk,esb-split";
        base-addr-0 = <0x53 0xB8 0x26 0xD1>;
        base-addr-1 = <0xA6 0x4C 0xE2 0x79>;
        addr-prefix = <0xE7 0xC2 0xC3 0xC4 0xC5 0xC6 0xC7 0xC8>;
    };
};
