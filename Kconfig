## boards/shields/cornix_esb_link/Kconfig.shield
```kconfig
config SHIELD_CORNIX_ESB_LINK
    def_bool $(shields_list_contains,cornix_esb_link)
```

## config/west.yml
```yaml
manifest:
  remotes:
    - name: zmkfirmware
      url-base: https://github.com/zmkfirmware
    - name: kumbung01
      url-base: https://github.com/kumbung01
    - name: nrfconnect
      url-base: https://github.com/nrfconnect
    - name: hitsmaxft
      url-base: https://github.com/hitsmaxft

  projects:
    - name: zmk
      remote: zmkfirmware
      revision: 4dd95d7840eb3d5a3f59bb29fbf1ab054715ef85
      clone-depth: 1
      import:
        file: app/west.yml

    - name: zmk-feature-split-esb
      remote: kumbung01
      revision: f7b1bd15bfc5e96f3301f328efb2a0df16918b98
      clone-depth: 1

    - name: sdk-nrf
      remote: kumbung01
      revision: 07b7e70c0d223429c58e6cffb4e6ecaa70ff949e
      path: nrf
      clone-depth: 1

    # NCS v3.1.1 crypto modules required by sdk-nrf's nrf_security CMake.
    - name: mbedtls
      remote: nrfconnect
      repo-path: sdk-mbedtls
      revision: c5115abac477249fab42e61368b8f87c3c9265e1
      path: modules/crypto/mbedtls
      clone-depth: 1

    - name: oberon-psa-crypto
      remote: nrfconnect
      repo-path: sdk-oberon-psa-crypto
      revision: d682b30a4498ecbaa8992e909b8d8c31f4988956
      path: modules/crypto/oberon-psa-crypto
      clone-depth: 1

    - name: nrfxlib
      remote: nrfconnect
      revision: 3b210a24d3bc7ecfc268e0feab6436306b11e7cb
      repo-path: sdk-nrfxlib
      path: nrfxlib
      clone-depth: 1

    - name: zmk-keyboard-cornix
      remote: hitsmaxft
      revision: v3.0.0
      clone-depth: 1

  self:
    path: config
```
